#include "test.h"
#include "stdio.h"
//---------------U8g2测试函数

#define SEND_BUFFER_DISPLAY_MS(u8g2, ms)\
  do {\
    u8g2_SendBuffer(u8g2); \
    HAL_Delay(ms);\
  }while(0);
 
 
//进度条显示
void testDrawProcess(u8g2_t *u8g2)
{
	for(int i=10;i<=80;i=i+2)
	{
		u8g2_ClearBuffer(u8g2); 
			
		char buff[20];
		sprintf(buff,"%d%%",(int)(i/80.0*100));
		
		u8g2_SetFont(u8g2,u8g2_font_ncenB12_tf);
		u8g2_DrawStr(u8g2,16,32,"STM32 U8g2");//字符显示
		
		u8g2_SetFont(u8g2,u8g2_font_ncenB08_tf);
		u8g2_DrawStr(u8g2,100,49,buff);//当前进度显示
		
		u8g2_DrawRBox(u8g2,16,40,i,10,4);//圆角填充框矩形框
		u8g2_DrawRFrame(u8g2,16,40,80,10,4);//圆角矩形
		
		u8g2_SendBuffer(u8g2);
	}
	HAL_Delay(500);
}

// 显示学号和昵称

// 汉字点阵数据
const unsigned char Hzk1[][32] = {
// 伍（序号0）
{0x08,0x00,0x0B,0xFC,0x08,0x40,0x10,0x40,0x10,0x40,0x30,0x40,0x33,0xF8,0x50,0x88,
0x90,0x88,0x10,0x88,0x10,0x88,0x11,0x08,0x11,0x08,0x11,0x08,0x17,0xFE,0x10,0x00},
// 丹（序号1）
{0x00,0x00,0x1F,0xF0,0x10,0x10,0x10,0x10,0x12,0x10,0x11,0x10,0x11,0x10,0x10,0x10,
0xFF,0xFE,0x10,0x10,0x10,0x10,0x10,0x10,0x20,0x10,0x20,0x10,0x40,0x50,0x80,0x20,},
// 妮（序号2）
{0x10,0x00,0x11,0xFC,0x11,0x04,0x11,0x04,0xFD,0x04,0x25,0xFC,0x25,0x00,0x25,0x40,
0x25,0x44,0x49,0x48,0x29,0x70,0x11,0x40,0x29,0x42,0x46,0x42,0x82,0x3E,0x04,0x00,}
};

// 在U8g2中显示汉字
void U8g2_ShowChinese(u8g2_t *u8g2, uint8_t x, uint8_t y, uint8_t num)
{
    uint8_t i, j;
    uint8_t byte1, byte2;
    
    for(i = 0; i < 16; i++) {  // 16行
        byte1 = Hzk1[num][i * 2];      // 高字节（左8列）
        byte2 = Hzk1[num][i * 2 + 1];  // 低字节（右8列）
        
        for(j = 0; j < 8; j++) {  // 处理左8列
            if(byte1 & (0x80 >> j)) {  // 从高位到低位
                u8g2_DrawPixel(u8g2, x + j, y + i);
            }
        }
        
        for(j = 0; j < 8; j++) {  // 处理右8列
            if(byte2 & (0x80 >> j)) {
                u8g2_DrawPixel(u8g2, x + 8 + j, y + i);
            }
        }
    }
}

// 显示学号和昵称
void testDrawInfo(u8g2_t *u8g2)
{
    int t = 2000;
    u8g2_ClearBuffer(u8g2);
    
    // 显示英文信息
    u8g2_SetFont(u8g2, u8g2_font_ncenB08_tf);
    u8g2_DrawStr(u8g2, 10, 15, "Name:");
    u8g2_DrawStr(u8g2, 10, 45, "ID:123456789123");
    
    // 显示中文"伍丹妮"
    U8g2_ShowChinese(u8g2, 50, 20, 0);  // 伍
    U8g2_ShowChinese(u8g2, 66, 20, 1);  // 丹
    U8g2_ShowChinese(u8g2, 82, 20, 2);  // 妮
    
    SEND_BUFFER_DISPLAY_MS(u8g2, t);
}

// 滑动显示测试（1:左右滑动 2:上下滑动）
void testSlideDisplay(u8g2_t *u8g2, uint8_t slide_type)
{
    int t = 30;  // 滑动步长间隔（越小越流畅）
    char slide_text[] = "U8g2 Slide Test!";  // 滑动显示的文本
    
    if (slide_type == 1)  // 1. 左右滑动（从右向左进入，再从左向右退出）
    {
        // 阶段1：文本从屏幕右侧滑入中间
        for (int x = 128; x >= 20; x -= 2)
        {
            u8g2_ClearBuffer(u8g2);
            u8g2_SetFont(u8g2, u8g2_font_ncenB10_tf);
            u8g2_DrawStr(u8g2, x, 32, slide_text);  // Y固定，X变化
            u8g2_SendBuffer(u8g2);
            HAL_Delay(t);
        }
        HAL_Delay(1000);  // 中间停留1秒
        
        // 阶段2：文本从中间滑出屏幕左侧
        for (int x = 20; x >= -128; x -= 2)
        {
            u8g2_ClearBuffer(u8g2);
            u8g2_DrawStr(u8g2, x, 32, slide_text);
            u8g2_SendBuffer(u8g2);
            HAL_Delay(t);
        }
    }
    else if (slide_type == 2)  // 2. 上下滑动（从下向上进入，再从上向下退出）
    {
        // 阶段1：文本从屏幕下方滑入中间
        for (int y = 64; y >= 32; y -= 2)
        {
            u8g2_ClearBuffer(u8g2);
            u8g2_SetFont(u8g2, u8g2_font_ncenB10_tf);
            u8g2_DrawStr(u8g2, 0, y, slide_text);  // X固定，Y变化
            u8g2_SendBuffer(u8g2);
            HAL_Delay(t);
        }
        HAL_Delay(1000);  // 中间停留1秒
        
        // 阶段2：文本从中间滑出屏幕上方
        for (int y = 32; y >= -20; y -= 2)
        {
            u8g2_ClearBuffer(u8g2);
            u8g2_DrawStr(u8g2, 0, y, slide_text);
            u8g2_SendBuffer(u8g2);
            HAL_Delay(t);
        }
    }
}
 
// 显示自定义图案
void testDrawCustomPattern(u8g2_t *u8g2)
{
    int t = 2000;  // 显示停留时间（2秒）
    u8g2_ClearBuffer(u8g2);
    u8g2_SetFont(u8g2, u8g2_font_ncenB08_tf);
    u8g2_DrawStr(u8g2, 0, 12, "Custom Pattern");  // 标题
    
    // 1. 绘制（坐标：中心X=40, Y=35）
    u8g2_DrawDisc(u8g2, 30, 30, 8, U8G2_DRAW_ALL);  // 左半圆
    u8g2_DrawDisc(u8g2, 50, 30, 8, U8G2_DRAW_ALL);  // 右半圆
    u8g2_DrawLine(u8g2, 22, 30, 40, 45);            // 左下方直线
    u8g2_DrawLine(u8g2, 58, 30, 40, 45);            // 右下方直线
    
    // 2. 绘制（坐标：中心X=90, Y=35）
    u8g2_DrawLine(u8g2, 90, 20, 98, 38);  // 上→右下
    u8g2_DrawLine(u8g2, 98, 38, 82, 28);  // 右下→左中
    u8g2_DrawLine(u8g2, 82, 28, 100, 28); // 左中→右中
    u8g2_DrawLine(u8g2, 100, 28, 84, 38); // 右中→左下
    u8g2_DrawLine(u8g2, 84, 38, 90, 20);  // 左下→上
    
    SEND_BUFFER_DISPLAY_MS(u8g2, t);  // 刷新显示并停留
}

//字体测试 数字英文可选用 u8g2_font_ncenB..(粗) 系列字体
//u8g2_font_unifont_t_symbols/u8g2_font_unifont_h_symbols(细 圆润)
void testShowFont(u8g2_t *u8g2)
{
	int t = 1000;
	char testStr[14] = "STM32F103C8T6";
	
	u8g2_ClearBuffer(u8g2);
	
	u8g2_SetFont(u8g2,u8g2_font_u8glib_4_tf);
	u8g2_DrawStr(u8g2,0,5,testStr);
	SEND_BUFFER_DISPLAY_MS(u8g2,t);
	
	u8g2_SetFont(u8g2,u8g2_font_ncenB08_tf);
	u8g2_DrawStr(u8g2,0,30,testStr);
	SEND_BUFFER_DISPLAY_MS(u8g2,t);
	
    u8g2_SetFont(u8g2,u8g2_font_ncenB10_tr);
	u8g2_DrawStr(u8g2,0,60,testStr);
	SEND_BUFFER_DISPLAY_MS(u8g2,t);
}
 
//画空心矩形
void testDrawFrame(u8g2_t *u8g2)
{
	int t = 1000;
	int x = 16;
	int y = 32;
	int w = 50;
	int h = 20;
	u8g2_ClearBuffer(u8g2);
	u8g2_DrawStr(u8g2,0, 15, "DrawFrame");
 
	u8g2_DrawFrame(u8g2, x, y, w, h);
	SEND_BUFFER_DISPLAY_MS(u8g2,t);
	u8g2_DrawFrame(u8g2, x+w+5, y-10, w-20, h+20);
	SEND_BUFFER_DISPLAY_MS(u8g2,t);
}
 
//画实心圆角矩形
void testDrawRBox(u8g2_t *u8g2)
{
	int t = 1000;
	int x = 16;
	int y = 32;
	int w = 50;
	int h = 20;
	int r = 3;
	u8g2_ClearBuffer(u8g2);
	u8g2_DrawStr(u8g2,0, 15, "DrawRBox");
 
	u8g2_DrawRBox(u8g2, x, y, w, h, r);
	SEND_BUFFER_DISPLAY_MS(u8g2,t);
	u8g2_DrawRBox(u8g2, x+w+5, y-10, w-20, h+20, r);
	SEND_BUFFER_DISPLAY_MS(u8g2,t);
}
 
//画空心圆
void testDrawCircle(u8g2_t *u8g2)
{
	int t = 600;
	int stx = 0;  //画图起始x
	int sty = 16; //画图起始y
	int with = 16;//一个图块的间隔
	int r = 15;   //圆的半径
	u8g2_ClearBuffer(u8g2);
	u8g2_DrawStr(u8g2, 0, 15, "DrawCircle");
 
	u8g2_DrawCircle(u8g2, stx, sty - 1 + with, r, U8G2_DRAW_UPPER_RIGHT); //右上
	SEND_BUFFER_DISPLAY_MS(u8g2,t);
	u8g2_DrawCircle(u8g2, stx + with, sty, r, U8G2_DRAW_LOWER_RIGHT); //右下
	SEND_BUFFER_DISPLAY_MS(u8g2,t);
	u8g2_DrawCircle(u8g2, stx - 1 + with * 3, sty - 1 + with, r, U8G2_DRAW_UPPER_LEFT); //左上
	SEND_BUFFER_DISPLAY_MS(u8g2,t);
	u8g2_DrawCircle(u8g2, stx - 1 + with * 4, sty, r, U8G2_DRAW_LOWER_LEFT); //左下
	SEND_BUFFER_DISPLAY_MS(u8g2,t);
	u8g2_DrawCircle(u8g2, stx - 1 + with * 2, sty - 1 + with * 2, r, U8G2_DRAW_ALL);//整个圆
	SEND_BUFFER_DISPLAY_MS(u8g2,t);
	
    u8g2_DrawCircle(u8g2, 32*3, 32, 31, U8G2_DRAW_ALL);//右侧整个圆
	SEND_BUFFER_DISPLAY_MS(u8g2,t);
}
 
//画实心椭圆
void testDrawFilledEllipse(u8g2_t *u8g2)
{
	int t = 800;
	int with = 16;//一个图块的间隔
	int rx = 27;  //椭圆x方向的半径
	int ry = 22;  //椭圆y方向的半径
	u8g2_ClearBuffer(u8g2);
	u8g2_DrawStr(u8g2,0, 14, "DrawFilledEllipse");
 
	SEND_BUFFER_DISPLAY_MS(u8g2,t);
	u8g2_DrawFilledEllipse(u8g2, 0, with, rx, ry, U8G2_DRAW_LOWER_RIGHT);//右下
	SEND_BUFFER_DISPLAY_MS(u8g2,t);
	u8g2_DrawFilledEllipse(u8g2, with * 4 - 1, with, rx, ry, U8G2_DRAW_LOWER_LEFT); //左下
	SEND_BUFFER_DISPLAY_MS(u8g2,t);
	u8g2_DrawFilledEllipse(u8g2, 0, with * 4 - 1, rx, ry, U8G2_DRAW_UPPER_RIGHT); //右上
	SEND_BUFFER_DISPLAY_MS(u8g2,t);
	u8g2_DrawFilledEllipse(u8g2, with * 4 - 1, with * 4 - 1, rx, ry, U8G2_DRAW_UPPER_LEFT); //左上
	SEND_BUFFER_DISPLAY_MS(u8g2,t);
	u8g2_DrawFilledEllipse(u8g2, with * 6, with * 2.5, rx, ry, U8G2_DRAW_ALL);//整个椭圆
	SEND_BUFFER_DISPLAY_MS(u8g2,t);
}
 
//环形测试
void testDrawMulti(u8g2_t *u8g2)
{
	u8g2_ClearBuffer(u8g2);
	for (int j = 0; j < 64; j+=16)
	{
		for (int i = 0; i < 128; i+=16)
		{
			u8g2_DrawPixel(u8g2, i, j);
			u8g2_SendBuffer(u8g2);
		}
	}
  
	//实心矩形逐渐变大
    u8g2_ClearBuffer(u8g2);
	for(int i=30; i>0; i-=2)
	{
		u8g2_DrawBox(u8g2,i*2,i,128-i*4,64-2*i);
		u8g2_SendBuffer(u8g2);
	}
	//空心矩形逐渐变小
	u8g2_ClearBuffer(u8g2);
	for(int i=0; i<32; i+=2)
	{
		u8g2_DrawFrame(u8g2,i*2,i,128-i*4,64-2*i);
		u8g2_SendBuffer(u8g2);
	}
	
	//实心圆角矩形逐渐变大
	u8g2_ClearBuffer(u8g2);
	for(int i=30; i>0; i-=2)
	{
		u8g2_DrawRBox(u8g2,i*2,i,128-i*4,64-2*i,10-i/3);
		u8g2_SendBuffer(u8g2);
	}
    //空心圆角矩形逐渐变小
	u8g2_ClearBuffer(u8g2);
	for(int i=0; i<32; i+=2)
	{
		u8g2_DrawRFrame(u8g2,i*2,i,128-i*4,64-2*i,10-i/3);
		u8g2_SendBuffer(u8g2);
	}
	
	//实心圆逐渐变大
	u8g2_ClearBuffer(u8g2);
	for(int i=2; i<64; i+=3)
	{
		u8g2_DrawDisc(u8g2,64,32,i, U8G2_DRAW_ALL);
		u8g2_SendBuffer(u8g2);
	}
	//空心圆逐渐变小
	u8g2_ClearBuffer(u8g2);
	for(int i=64; i>0; i-=3)
	{
		u8g2_DrawCircle(u8g2,64,32,i, U8G2_DRAW_ALL);
		u8g2_SendBuffer(u8g2);
	}
	
	//实心椭圆逐渐变大
    u8g2_ClearBuffer(u8g2);
	for(int i=2; i<32; i+=3)
	{
		u8g2_DrawFilledEllipse(u8g2,64,32, i*2, i, U8G2_DRAW_ALL);
		u8g2_SendBuffer(u8g2);
	}
    //空心椭圆逐渐变小
    u8g2_ClearBuffer(u8g2);
	for(int i=32; i>0; i-=3)
	{
		u8g2_DrawEllipse(u8g2,64,32, i*2, i, U8G2_DRAW_ALL);
		u8g2_SendBuffer(u8g2);
	}
}
 
 
// width: 128, height: 48
const unsigned char bilibili[] U8X8_PROGMEM = { 0x00, 0x00, 0x00, 0x00, 0x00, 0x00, 0x00, 0x00, 0x00, 0x00, 0x00, 0x00, 0x00,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 0x00, 0x00 };
// width: 128, height: 48
const unsigned char three_support[] U8X8_PROGMEM = { 0x00, 0x00, 0x00, 0x00, 0x00, 0x00, 0x00, 0x00, 0x00, 0x00, 0x00, 0x00, 0x00,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 0x00, 0x00 };
 
void testDrawXBM(u8g2_t *u8g2)
{
	int t = 1000;
	u8g2_ClearBuffer(u8g2);
	u8g2_DrawStr(u8g2,0, 14, "DrawXBM");
 
	u8g2_DrawXBM(u8g2,0, 16, 128, 48, bilibili);
	SEND_BUFFER_DISPLAY_MS(u8g2,t);
 
	u8g2_ClearBuffer(u8g2);
	u8g2_DrawStr(u8g2,0, 14, "bilibili");
	u8g2_DrawXBM(u8g2,0, 16, 128, 48, three_support);
	SEND_BUFFER_DISPLAY_MS(u8g2,t);
}



// 最新图片数据（替换为你提供的新数据）
//取128*64 逐行式 顺向高位在前
static const unsigned char pic1[] =
{
   
0x00,0x00,0x00,0x00,0x00,0x00,0x00,0x00,0x00,0x00,0x00,0x00,0x00,0x00,0x00,0x00,
    0x00,0x00,0x00,0x00,0x00,0x00,0x00,0x00,0x00,0x00,0x00,0x00,0x00,0x00,0x00,0x00,
    0x00,0x00,0x00,0x00,0x00,0x00,0x00,0x00,0x00,0x00,0x00,0x00,0x00,0x00,0x00,0x00,
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    0x00,0x00,0x00,0x00,0x00,0x00,0x00,0xE0,0x00,0x00,0x00,0x00,0x00,0x00,0x00,0x00
};


/**
 * @brief 显示逐行式取模的图片（适配U8g2库）
 * @param u8g2: U8g2结构体指针
 * @param x,y: 显示起点坐标
 * @param width,height: 图片宽高（必须128×64，与数据匹配）
 * @param pic: 图片数据指针（逐行式取模，顺向高位在前）
 * @param mode: 显示模式（1:正常显示 0:反色显示）
 */

void U8g2_ShowRowImage(u8g2_t *u8g2, uint8_t x, uint8_t y, const uint8_t *pic)
{
    // 1. 全屏清屏（消除背景干扰）
    u8g2_SetDrawColor(u8g2, 0);
    u8g2_DrawBox(u8g2, 0, 0, 128, 64);

    uint8_t temp, bit;
    uint16_t i = 0;

    // 遍历列（假设图片宽度为113列，每列8个点为1字节，共113列）
    for (uint8_t col = 0; col < 48; col++) {
        // 遍历行（共64行，每8行对应1字节）
        for (uint8_t row = 0; row < 64; row++) {
            if (row % 8 == 0) {
                temp = pic[i++]; // 每8行读取1个字节
            }
            bit = row % 8;

            // 绘制有效像素：当字节中对应位为1时绘制（阴码：1表示前景像素）
            // 同时保留“非边缘”判断（col>2 && col<110 && row>2 && row<61）
            if ((temp & (0x80 >> bit)) && col > 2 && col < 110 && row > 2 && row < 61) {
                u8g2_SetDrawColor(u8g2, 1);
                u8g2_DrawPixel(u8g2, x + col, y + row);
            }
        }
    }
}


/**
 * @brief U8g2绘图测试主函数
 * @param u8g2: U8g2结构体指针
 */
void u8g2DrawTest(u8g2_t *u8g2)
{
    // 原有测试功能
    testDrawProcess(u8g2);
    testDrawMulti(u8g2);
    testShowFont(u8g2);
    testDrawXBM(u8g2);
    
    // 新增测试功能
    testDrawInfo(u8g2);          // 显示学号和昵称
    testSlideDisplay(u8g2, 1);   // 左右滑动显示
    testSlideDisplay(u8g2, 2);   // 上下滑动显示
	testDrawFilledEllipse(u8g2);


   // 显示图片
   u8g2_ClearBuffer(u8g2);
    u8g2_SetFont(u8g2, u8g2_font_ncenB08_tf);
    // 逐行式取模数据，从(0,12)开始全屏显示
    U8g2_ShowRowImage(u8g2, 32, 5, pic1);
    u8g2_SendBuffer(u8g2);
    HAL_Delay(5000);


}

